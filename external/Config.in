## external/Config.in
```kconfig
source "$BR2_EXTERNAL_beaglehoarder_PATH/package/uuu-target/Config.in"
source "$BR2_EXTERNAL_beaglehoarder_PATH/package/tarmfg/Config.in"
```

## external/package/uuu-target/Config.in
```kconfig
comment "mfgtools-UUU needs gcc >= 4.8"
	depends on !BR2_TOOLCHAIN_GCC_AT_LEAST_4_8
config BR2_PACKAGE_UUU_TARGET
        bool "UUU-target"
        depends on BR2_arm
        depends on BR2_TOOLCHAIN_GCC_AT_LEAST_4_8 # needs C++11
	select BR2_PACKAGE_LIBUSB
        help
          This package contains the Freescale manufacturing tool.
          It is designed to program firmware to i.MX boards during
          production. The communication is done over USB using the
          Freescale UTP protocol.

          https://github.com/codeauroraforum/mfgtools
```
